/* Copyright (c) 2012, Code Aurora Forum. All rights reserved.
 *
 * This program is free software; you can redistribute it and/or modify
 * it under the terms of the GNU General Public License version 2 and
 * only version 2 as published by the Free Software Foundation.
 *
 * This program is distributed in the hope that it will be useful,
 * but WITHOUT ANY WARRANTY; without even the implied warranty of
 * MERCHANTABILITY or FITNESS FOR A PARTICULAR PURPOSE.  See the
 * GNU General Public License for more details.
 */

 /*---------------------------------------------------------------------------
 * This file is autogenerated file using gcdb parser. Please do not edit it.
 * Update input XML file to add a new entry or update variable in this file
 * VERSION = "1.0"
 *file name:dsi-panel-zte-lead-nt35521-cpt-5p5-720p-video.h
 *author   :created by tangzhengbo at 20150109
 *when        who(by)      who(from)  why
 *2015.01.09  tangzhengbo  hanwenjun  create
 *---------------------------------------------------------------------------*/

&mdss_mdp {
	dsi_dijing_ili9881c_cmi_5p5_720p_video: qcom,mdss_dsi_dijing_ili9881c_cmi_5p5_720p_video {
		qcom,mdss-dsi-panel-name =  "zteDijing(ili9881c)cmi_720*1280_5.5Inch";
		qcom,zte-enable-12bit-bl-ctl;//only for this panel!!!!!!!
		qcom,cont-splash-enabled;
		qcom,mdss-dsi-panel-controller = <&mdss_dsi0>;
		qcom,mdss-dsi-panel-type = "dsi_video_mode";
		qcom,mdss-dsi-panel-destination = "display_1";
		qcom,mdss-dsi-panel-framerate = <60>;
		qcom,mdss-dsi-virtual-channel-id = <0>;
		qcom,mdss-dsi-stream = <0>;
		qcom,mdss-pan-physical-height-dimension = <121>;
		qcom,mdss-pan-physical-width-dimension = <68>;
		qcom,mdss-dsi-panel-width = <720>;
		qcom,mdss-dsi-panel-height = <1280>;

		qcom,mdss-dsi-h-front-porch = <50>;//mipi clk=388.19M
		qcom,mdss-dsi-h-back-porch = <30>;
		qcom,mdss-dsi-h-pulse-width = <20>;
		qcom,mdss-dsi-h-sync-skew = <0>;
		qcom,mdss-dsi-v-front-porch = <15>;
		qcom,mdss-dsi-v-back-porch = <12>;
		qcom,mdss-dsi-v-pulse-width = <8>;

		qcom,mdss-dsi-h-left-border = <0>;
		qcom,mdss-dsi-h-right-border = <0>;
		qcom,mdss-dsi-v-top-border = <0>;
		qcom,mdss-dsi-v-bottom-border = <0>;
		qcom,mdss-dsi-bpp = <24>;
		qcom,mdss-dsi-color-order = <0>;
		qcom,mdss-dsi-underflow-color = <0xff>;
		qcom,mdss-dsi-border-color = <0>;
		qcom,mdss-dsi-h-sync-pulse = <0>;
		/* ESD check need to use burst_mode on this platform */
		qcom,mdss-dsi-traffic-mode = "burst_mode";
		//qcom,mdss-dsi-traffic-mode = <1>;
		qcom,mdss-dsi-lane-map = "lane_map_0123";
		qcom,mdss-dsi-bllp-eof-power-mode;
		qcom,mdss-dsi-bllp-power-mode;
		qcom,suspend-ulps-enabled;
		qcom,mdss-dsi-lane-0-state;
		qcom,mdss-dsi-lane-1-state;
		qcom,mdss-dsi-lane-2-state;
		qcom,mdss-dsi-lane-3-state;
		qcom,mdss-dsi-lp11-init;
		qcom,mdss-dsi-panel-timings =[76 18 10 00 3A 3E 14 1c 12 03 04 a0];
		qcom,mdss-dsi-t-clk-post = <0x04>;
		qcom,mdss-dsi-t-clk-pre = <0x19>;
		qcom,mdss-dsi-bl-min-level = <1>;
		qcom,mdss-dsi-bl-max-level = <255>;
		qcom,mdss-dsi-dma-trigger = <0x04>;
		qcom,mdss-dsi-mdp-trigger = <0x0>;
		qcom,mdss-dsi-bl-pmic-control-type = "bl_ctrl_dcs";
		//qcom,mdss-dsi-bl-cmd-gpio = <&msmgpio 33 0>;
		qcom,mdss-dsi-reset-sequence = <1 5>, <0 5>, <1 20>;

		qcom,mdss-dsi-panel-status-command = [06 01 00 01 05 00 01 0A];
		qcom,mdss-dsi-panel-status-command-mode = "dsi_lp_mode";
		qcom,mdss-dsi-panel-status-check-mode = "reg_read";
		qcom,mdss-dsi-panel-status-read-length = <1>;
		//qcom,mdss-dsi-panel-status-valid-params = <1>;
		//qcom,mdss-dsi-panel-max-error-count = <3>;
		qcom,mdss-dsi-panel-status-value = <0x9c>;
		qcom,esd-check-enabled; //enables ESD
		//qcom,mdss-dsi-rx-eot-ignore;
		//qcom,mdss-dsi-tx-eot-append;
		qcom,mdss-dsi-on-command = [
			39 01 00 00 00 00 04 FF 98 81 03
			39 01 00 00 00 00 02 01 00
			39 01 00 00 00 00 02 02 00
			39 01 00 00 00 00 02 03 53
			39 01 00 00 00 00 02 04 53
			39 01 00 00 00 00 02 05 13
			39 01 00 00 00 00 02 06 04
			39 01 00 00 00 00 02 07 02
			39 01 00 00 00 00 02 08 02
			39 01 00 00 00 00 02 09 00
			39 01 00 00 00 00 02 0a 00
			39 01 00 00 00 00 02 0b 00
			39 01 00 00 00 00 02 0c 00
			39 01 00 00 00 00 02 0d 00
			39 01 00 00 00 00 02 0e 00
			39 01 00 00 00 00 02 0f 00
			39 01 00 00 00 00 02 10 00
			39 01 00 00 00 00 02 11 00
			39 01 00 00 00 00 02 12 00
			39 01 00 00 00 00 02 13 00
			39 01 00 00 00 00 02 14 00
			39 01 00 00 00 00 02 15 00
			39 01 00 00 00 00 02 16 00
			39 01 00 00 00 00 02 17 00
			39 01 00 00 00 00 02 18 00
			39 01 00 00 00 00 02 19 00
			39 01 00 00 00 00 02 1a 00
			39 01 00 00 00 00 02 1b 00
			39 01 00 00 00 00 02 1c 00
			39 01 00 00 00 00 02 1d 00
			39 01 00 00 00 00 02 1e C0
			39 01 00 00 00 00 02 1f 80
			39 01 00 00 00 00 02 20 02
			39 01 00 00 00 00 02 21 09
			39 01 00 00 00 00 02 22 00
			39 01 00 00 00 00 02 23 00
			39 01 00 00 00 00 02 24 00
			39 01 00 00 00 00 02 25 00
			39 01 00 00 00 00 02 26 00
			39 01 00 00 00 00 02 27 00
			39 01 00 00 00 00 02 28 55
			39 01 00 00 00 00 02 29 03
			39 01 00 00 00 00 02 2a 00
			39 01 00 00 00 00 02 2b 00
			39 01 00 00 00 00 02 2c 00
			39 01 00 00 00 00 02 2d 00
			39 01 00 00 00 00 02 2e 00
			39 01 00 00 00 00 02 2f 00
			39 01 00 00 00 00 02 30 00
			39 01 00 00 00 00 02 31 00
			39 01 00 00 00 00 02 32 00
			39 01 00 00 00 00 02 33 00
			39 01 00 00 00 00 02 34 03
			39 01 00 00 00 00 02 35 00
			39 01 00 00 00 00 02 36 05
			39 01 00 00 00 00 02 37 00
			39 01 00 00 00 00 02 38 3C
			39 01 00 00 00 00 02 39 00
			39 01 00 00 00 00 02 3a 00
			39 01 00 00 00 00 02 3b 00
			39 01 00 00 00 00 02 3c 00
			39 01 00 00 00 00 02 3d 00
			39 01 00 00 00 00 02 3e 00
			39 01 00 00 00 00 02 3f 00
			39 01 00 00 00 00 02 40 00
			39 01 00 00 00 00 02 41 00
			39 01 00 00 00 00 02 42 00
			39 01 00 00 00 00 02 43 00
			39 01 00 00 00 00 02 44 00
			39 01 00 00 00 00 02 50 01
			39 01 00 00 00 00 02 51 23
			39 01 00 00 00 00 02 52 45
			39 01 00 00 00 00 02 53 67
			39 01 00 00 00 00 02 54 89
			39 01 00 00 00 00 02 55 ab
			39 01 00 00 00 00 02 56 01
			39 01 00 00 00 00 02 57 23
			39 01 00 00 00 00 02 58 45
			39 01 00 00 00 00 02 59 67
			39 01 00 00 00 00 02 5a 89
			39 01 00 00 00 00 02 5b ab
			39 01 00 00 00 00 02 5c cd
			39 01 00 00 00 00 02 5d ef
			39 01 00 00 00 00 02 5e 01
			39 01 00 00 00 00 02 5f 14
			39 01 00 00 00 00 02 60 15
			39 01 00 00 00 00 02 61 0C
			39 01 00 00 00 00 02 62 0D
			39 01 00 00 00 00 02 63 0E
			39 01 00 00 00 00 02 64 0F
			39 01 00 00 00 00 02 65 10
			39 01 00 00 00 00 02 66 11
			39 01 00 00 00 00 02 67 08
			39 01 00 00 00 00 02 68 02
			39 01 00 00 00 00 02 69 0A
			39 01 00 00 00 00 02 6a 02
			39 01 00 00 00 00 02 6b 02
			39 01 00 00 00 00 02 6c 02
			39 01 00 00 00 00 02 6d 02
			39 01 00 00 00 00 02 6e 02
			39 01 00 00 00 00 02 6f 02
			39 01 00 00 00 00 02 70 02
			39 01 00 00 00 00 02 71 02
			39 01 00 00 00 00 02 72 06
			39 01 00 00 00 00 02 73 02
			39 01 00 00 00 00 02 74 02
			39 01 00 00 00 00 02 75 14
			39 01 00 00 00 00 02 76 15
			39 01 00 00 00 00 02 77 0F
			39 01 00 00 00 00 02 78 0E
			39 01 00 00 00 00 02 79 0D
			39 01 00 00 00 00 02 7a 0C
			39 01 00 00 00 00 02 7b 11
			39 01 00 00 00 00 02 7c 10
			39 01 00 00 00 00 02 7d 06
			39 01 00 00 00 00 02 7e 02
			39 01 00 00 00 00 02 7f 0A
			39 01 00 00 00 00 02 80 02
			39 01 00 00 00 00 02 81 02
			39 01 00 00 00 00 02 82 02
			39 01 00 00 00 00 02 83 02
			39 01 00 00 00 00 02 84 02
			39 01 00 00 00 00 02 85 02
			39 01 00 00 00 00 02 86 02
			39 01 00 00 00 00 02 87 02
			39 01 00 00 00 00 02 88 08
			39 01 00 00 00 00 02 89 02
			39 01 00 00 00 00 02 8A 02
			39 01 00 00 00 00 04 FF 98 81 04
			39 01 00 00 00 00 02 00 80
			39 01 00 00 00 00 02 6C 15
			39 01 00 00 00 00 02 6E 2F
			39 01 00 00 00 00 02 6F 55
			39 01 00 00 00 00 02 3A A4
			39 01 00 00 00 00 02 8D 1F
			39 01 00 00 00 00 02 87 BA
			39 01 00 00 00 00 02 26 76
			39 01 00 00 00 00 02 B2 D1
			39 01 00 00 00 00 02 88 0B
			39 01 00 00 00 00 04 FF 98 81 01
			39 01 00 00 00 00 02 22 0A
			39 01 00 00 00 00 02 31 00
			39 01 00 00 00 00 02 53 8A
			39 01 00 00 00 00 02 55 88
			39 01 00 00 00 00 02 50 a6
			39 01 00 00 00 00 02 51 a6
			39 01 00 00 00 00 02 60 2B
			39 01 00 00 00 00 02 A0 08
			39 01 00 00 00 00 02 A1 1E
			39 01 00 00 00 00 02 A2 2C
			39 01 00 00 00 00 02 A3 15
			39 01 00 00 00 00 02 A4 18
			39 01 00 00 00 00 02 A5 2A
			39 01 00 00 00 00 02 A6 1F
			39 01 00 00 00 00 02 A7 1F
			39 01 00 00 00 00 02 A8 85
			39 01 00 00 00 00 02 A9 1C
			39 01 00 00 00 00 02 AA 2A
			39 01 00 00 00 00 02 AB 72
			39 01 00 00 00 00 02 AC 1A
			39 01 00 00 00 00 02 AD 18
			39 01 00 00 00 00 02 AE 4C
			39 01 00 00 00 00 02 AF 20
			39 01 00 00 00 00 02 B0 26
			39 01 00 00 00 00 02 B1 4A
			39 01 00 00 00 00 02 B2 57
			39 01 00 00 00 00 02 B3 2C
			39 01 00 00 00 00 02 C0 08
			39 01 00 00 00 00 02 C1 1B
			39 01 00 00 00 00 02 C2 27
			39 01 00 00 00 00 02 C3 12
			39 01 00 00 00 00 02 C4 14
			39 01 00 00 00 00 02 C5 25
			39 01 00 00 00 00 02 C6 1A
			39 01 00 00 00 00 02 C7 1D
			39 01 00 00 00 00 02 C8 7A
			39 01 00 00 00 00 02 C9 1A
			39 01 00 00 00 00 02 CA 28
			39 01 00 00 00 00 02 CB 6B
			39 01 00 00 00 00 02 CC 1F
			39 01 00 00 00 00 02 CD 1D
			39 01 00 00 00 00 02 CE 52
			39 01 00 00 00 00 02 CF 24
			39 01 00 00 00 00 02 D0 2D
			39 01 00 00 00 00 02 D1 47
			39 01 00 00 00 00 02 D2 55
			39 01 00 00 00 00 02 D3 2C
			39 01 00 00 00 00 04 FF 98 81 02
			39 01 00 00 00 00 02 06 20
			39 01 00 00 00 00 02 07 00
			39 01 00 00 00 00 04 FF 98 81 00
			39 01 00 00 00 00 02 35 00
			39 01 00 00 00 00 02 51 80
			39 01 00 00 00 00 02 53 2C

			05 01 00 00 78 00 02 11 00
			05 01 00 00 0a 00 02 29 00
		];
		qcom,mdss-dsi-on-command-state = "dsi_lp_mode";
		qcom,mdss-dsi-off-command = [
		05 01 00 00 00 00 02 28 00
		05 01 00 00 78 00 02 10 00
		15 01 00 00 00 00 02 4f 01];
		qcom,mdss-dsi-off-command-state = "dsi_hs_mode";
	};
};
