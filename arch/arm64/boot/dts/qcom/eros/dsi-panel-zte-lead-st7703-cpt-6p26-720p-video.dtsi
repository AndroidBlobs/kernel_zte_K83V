/* Copyright (c) 2013, The Linux Foundation. All rights reserved.
 *
 * This program is free software; you can redistribute it and/or modify
 * it under the terms of the GNU General Public License version 2 and
 * only version 2 as published by the Free Software Foundation.
 *
 * This program is distributed in the hope that it will be useful,
 * but WITHOUT ANY WARRANTY; without even the implied warranty of
 * MERCHANTABILITY or FITNESS FOR A PARTICULAR PURPOSE.  See the
 * GNU General Public License for more details.
 */

/*---------------------------------------------------------------------------
 * This file is autogenerated file using gcdb parser. Please do not edit it.
 * Update input XML file to add a new entry or update variable in this file
 * VERSION = "1.0"
 *---------------------------------------------------------------------------*/
&mdss_mdp {
	dsi_lead_st7703_cpt_720p_video: qcom,mdss_dsi_lead_st7703_cpt_720p_video {
		qcom,mdss-dsi-panel-name = "lead st7703 cpt 720p video mode dsi panel";
		zte,lcd-init-code-version = "20181129";
		qcom,cont-splash-enabled;
		qcom,panel-supply-entries = <&dsi_panel_pwr_supply>;
		qcom,mdss-dsi-panel-controller = <&mdss_dsi0>;
		qcom,mdss-dsi-panel-type = "dsi_video_mode";
		qcom,mdss-dsi-panel-destination = "display_1";
		qcom,mdss-dsi-panel-framerate = <60>;
		/*qcom,mdss-dsi-panel-clockrate = <866400000>;*/
		qcom,mdss-dsi-virtual-channel-id = <0>;
		qcom,mdss-dsi-stream = <0>;
		qcom,mdss-dsi-panel-width = <720>;
		qcom,mdss-dsi-panel-height = <1520>;
		qcom,mdss-dsi-h-front-porch = <80>;
		qcom,mdss-dsi-h-back-porch = <80>;
		qcom,mdss-dsi-h-pulse-width = <8>;
		qcom,mdss-dsi-h-sync-skew = <0>;
		qcom,mdss-dsi-v-back-porch = <24>;
		qcom,mdss-dsi-v-front-porch = <16>;
		qcom,mdss-dsi-v-pulse-width = <4>;
		qcom,mdss-dsi-h-left-border = <0>;
		qcom,mdss-dsi-h-right-border = <0>;
		qcom,mdss-dsi-v-top-border = <0>;
		qcom,mdss-dsi-v-bottom-border = <0>;
		qcom,mdss-dsi-bpp = <24>;
		qcom,mdss-dsi-color-order = "rgb_swap_rgb";
		qcom,mdss-dsi-underflow-color = <0xff>;
		qcom,mdss-dsi-border-color = <0>;
		qcom,mdss-dsi-on-command = [39 01 00 00 00 00 04 b9 f1 12 83
39 01 00 00 00 00 1c ba 33 81 05 f9 0e 0e 20 00 00 00 00 00 00 00 44 25 00 91 0a 00 00 02 4f 01 00 00 37
39 01 00 00 00 00 05 b8 76 22 20 03
39 01 00 00 00 00 0b b3 0c 10 05 05 03 ff 00 00 00 00
39 01 00 00 00 00 0a c0 73 73 50 50 a0 00 08 50 00
39 01 00 00 00 00 02 bc 4f
39 01 00 00 00 00 02 cc 0b
39 01 00 00 00 00 02 b4 80
39 01 00 00 00 00 05 b1 85 00 00 01
39 01 00 00 00 00 04 b2 04 12 30
39 01 00 00 00 00 0f e3 07 07 0b 0b 03 03 00 00 00 00 2f 80 c0 10
39 01 00 00 00 00 0d c1 54 c0 2a 2a 99 d1 ff ff ae ae 7f 7f
39 01 00 00 00 00 07 c6 01 04 ff ff 00 20
39 01 00 00 00 00 03 b5 19 19
39 01 00 00 00 00 03 b6 43 43
39 01 00 00 00 00 04 bf 02 11 00
39 01 00 00 00 00 40 e9 c2 10 04 05 f0 80 81 12 31 23 5f 81 30 b1 37 0a
			00 80 02 00 00 00 00 80 02 00 00 00 84 f0 24 68
			88 88 88 80 88 88 88 85 f1 35 78 88 88 88 81 88
			88 88 00 00 00 00 00 00 00 00 00 00 00 00 00
39 01 00 00 00 00 3e ea 00 1a 00 00 00 00 02 00 00 00 00 00 f1 87 53 18
			88 88 88 85 88 88 88 f0 86 42 08 88 88 88 84 88
			88 88 23 20 00 00 24 00 00 00 00 00 00 00 00 00
			00 00 00 00 00 00 50 80 81 00 00 00 00
39 01 00 00 00 00 23 e0 00 0F 1A 32 3F 3F 53 46 08 0E 0E 11 13 11 13 12
			19 00 0F 1A 32 3F 3F 53 46 08 0E 0E 11 13 11 13
			12 19
39 01 00 00 00 00 04 c8 10 01 02
39 01 00 00 00 00 02 51 00
39 01 00 00 00 00 02 53 2c
39 01 00 00 00 00 02 55 01
39 01 00 00 00 00 02 5e 04
05 01 00 00 78 00 02 11 00
05 01 00 00 20 00 02 29 00
39 01 00 00 00 00 02 c7 b0];
		qcom,mdss-dsi-off-command = [39 01 00 00 00 00 02 53 00
					05 01 00 00 32 00 02 28 00
					05 01 00 00 78 00 02 10 00];
		qcom,mdss-dsi-on-command-state = "dsi_lp_mode";
		qcom,mdss-dsi-off-command-state = "dsi_lp_mode";
		zte,mdss-dsi-cabc-default-value = <0x01>;
		zte,mdss-dsi-cabc-off-command = [39 01 00 00 00 00 02 55 00
		];
		zte,mdss-dsi-cabc-low-command = [39 01 00 00 00 00 02 55 01
		];
		zte,mdss-dsi-cabc-medium-command = [39 01 00 00 00 00 02 55 02
		];
		zte,mdss-dsi-cabc-high-command = [39 01 00 00 00 00 02 55 03
		];
		zte,mdss-dsi-cabc-command-state = "dsi_lp_mode";
		qcom,mdss-dsi-lp11-init;
		qcom,mdss-dsi-h-sync-pulse = <1>;
		qcom,mdss-dsi-traffic-mode = "burst_mode";
		qcom,mdss-dsi-lane-map = "lane_map_0123";
		qcom,mdss-dsi-bllp-eof-power-mode;
		qcom,mdss-dsi-bllp-power-mode;
		qcom,mdss-dsi-lane-0-state;
		qcom,mdss-dsi-lane-1-state;
		qcom,mdss-dsi-lane-2-state;
		qcom,mdss-dsi-lane-3-state;
		/*qcom,mdss-dsi-panel-timings = [8B 1E 14 00 44 4A 18 22 19 03 04 00];*/
		qcom,mdss-dsi-panel-timings-phy-12nm = [0A 07 0A 03 00 05 03 03];
		qcom,mdss-dsi-t-clk-post = <0x04>;
		qcom,mdss-dsi-t-clk-pre = <0x1C>;
		qcom,mdss-dsi-bl-min-level = <4>;
		qcom,mdss-dsi-bl-max-level = <255>;
		qcom,mdss-dsi-dma-trigger = "trigger_sw";
		qcom,mdss-dsi-mdp-trigger = "none";
		qcom,mdss-dsi-bl-pmic-control-type = "bl_ctrl_dcs";
		qcom,mdss-dsi-reset-sequence = <1 1>, <0 1>, <1 15>;
		qcom,mdss-pan-physical-width-dimension = <68>;
		qcom,mdss-pan-physical-height-dimension = <143>;
		zte,lcm_backlight_curve_mode = "lcd_brightness_max_350_lux";
		qcom,mdss-dsi-tx-eot-append;
		qcom,esd-check-enabled;
		qcom,mdss-dsi-panel-status-command=[06 01 00 01 05 00 02 09 00
						06 01 00 01 05 00 02 0A 00
						06 01 00 01 05 00 02 68 00];
		qcom,mdss-dsi-panel-status-command-state="dsi_lp_mode";
		qcom,mdss-dsi-panel-status-check-mode="reg_read";
		qcom,mdss-dsi-panel-status-value=<0x80 0x9c 0xc0>;
		qcom,mdss-dsi-panel-status-read-length = <1 1 1>;
		qcom,mdss-dsi-panel-status-valid-params = <1 1 1>;
	};
};
