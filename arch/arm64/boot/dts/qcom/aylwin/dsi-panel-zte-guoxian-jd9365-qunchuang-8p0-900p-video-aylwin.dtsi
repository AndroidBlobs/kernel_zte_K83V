/* Copyright (c) 2013, The Linux Foundation. All rights reserved.
 *
 * This program is free software; you can redistribute it and/or modify
 * it under the terms of the GNU General Public License version 2 and
 * only version 2 as published by the Free Software Foundation.
 *
 * This program is distributed in the hope that it will be useful,
 * but WITHOUT ANY WARRANTY; without even the implied warranty of
 * MERCHANTABILITY or FITNESS FOR A PARTICULAR PURPOSE.  See the
 * GNU General Public License for more details.
 */

/*---------------------------------------------------------------------------
 * This file is autogenerated file using gcdb parser. Please do not edit it.
 * Update input XML file to add a new entry or update variable in this file
 * VERSION = "1.0"
 *---------------------------------------------------------------------------*/
&mdss_mdp {
	dsi_guoxian_jd9365_800p_video: qcom,mdss_dsi_guoxian_jd9365_800p_video {
		qcom,mdss-dsi-panel-name = "guoxian jd9365 800p video mode dsi panel";
		zte,lcd-init-code-version = "20190527";
		qcom,cont-splash-enabled;
		qcom,panel-supply-entries = <&dsi_panel_pwr_supply>;
		qcom,mdss-dsi-panel-controller = <&mdss_dsi0>;
		qcom,mdss-dsi-panel-type = "dsi_video_mode";
		qcom,mdss-dsi-panel-destination = "display_1";
		qcom,mdss-dsi-panel-framerate = <60>;
		/*qcom,mdss-dsi-panel-clockrate = <866400000>;*/
		qcom,mdss-dsi-virtual-channel-id = <0>;
		qcom,mdss-dsi-stream = <0>;
		qcom,mdss-dsi-panel-width = <800>;
		qcom,mdss-dsi-panel-height = <1280>;
		qcom,mdss-dsi-h-front-porch = <20>;
		qcom,mdss-dsi-h-back-porch = <20>;
		qcom,mdss-dsi-h-pulse-width = <20>;
		qcom,mdss-dsi-h-sync-skew = <0>;
		qcom,mdss-dsi-v-back-porch = <8>;
		qcom,mdss-dsi-v-front-porch = <30>;
		qcom,mdss-dsi-v-pulse-width = <4>;
		qcom,mdss-dsi-h-left-border = <0>;
		qcom,mdss-dsi-h-right-border = <0>;
		qcom,mdss-dsi-v-top-border = <0>;
		qcom,mdss-dsi-v-bottom-border = <0>;
		qcom,mdss-dsi-bpp = <24>;
		qcom,mdss-dsi-color-order = "rgb_swap_rgb";
		qcom,mdss-dsi-underflow-color = <0xff>;
		qcom,mdss-dsi-border-color = <0>;
		qcom,mdss-dsi-on-command = [
		39 01 00 00 00 00 02 E0 00
		39 01 00 00 00 00 02 E1 93
		39 01 00 00 00 00 02 E2 65
		39 01 00 00 00 00 02 E3 F8
		39 01 00 00 00 00 02 80 03
		39 01 00 00 00 00 02 E0 01
		39 01 00 00 00 00 02 00 00
		39 01 00 00 00 00 02 01 3C
		39 01 00 00 00 00 02 03 00
		39 01 00 00 00 00 02 04 3c
		39 01 00 00 00 00 02 17 00
		39 01 00 00 00 00 02 18 F7
		39 01 00 00 00 00 02 19 01
		39 01 00 00 00 00 02 1A 00
		39 01 00 00 00 00 02 1B F7
		39 01 00 00 00 00 02 1C 01
		39 01 00 00 00 00 02 24 F1
		39 01 00 00 00 00 02 35 23
		39 01 00 00 00 00 02 37 09
		39 01 00 00 00 00 02 38 04
		39 01 00 00 00 00 02 39 00
		39 01 00 00 00 00 02 3A 01
		39 01 00 00 00 00 02 3C 70
		39 01 00 00 00 00 02 3D FF
		39 01 00 00 00 00 02 3E FF
		39 01 00 00 00 00 02 3F 7F
		39 01 00 00 00 00 02 40 06
		39 01 00 00 00 00 02 41 A0
		39 01 00 00 00 00 02 43 1E
		39 01 00 00 00 00 02 44 0B
		39 01 00 00 00 00 02 45 28
		39 01 00 00 00 00 02 55 01
		39 01 00 00 00 00 02 57 69
		39 01 00 00 00 00 02 59 0A
		39 01 00 00 00 00 02 5A 2D
		39 01 00 00 00 00 02 5B 1A
		39 01 00 00 00 00 02 5C 15
		39 01 00 00 00 00 02 5D 7F
		39 01 00 00 00 00 02 5E 69
		39 01 00 00 00 00 02 5F 59
		39 01 00 00 00 00 02 60 4C
		39 01 00 00 00 00 02 61 47
		39 01 00 00 00 00 02 62 38
		39 01 00 00 00 00 02 63 3D
		39 01 00 00 00 00 02 64 27
		39 01 00 00 00 00 02 65 41
		39 01 00 00 00 00 02 66 40
		39 01 00 00 00 00 02 67 40
		39 01 00 00 00 00 02 68 5B
		39 01 00 00 00 00 02 69 46
		39 01 00 00 00 00 02 6A 49
		39 01 00 00 00 00 02 6B 3A
		39 01 00 00 00 00 02 6C 34
		39 01 00 00 00 00 02 6D 25
		39 01 00 00 00 00 02 6E 15
		39 01 00 00 00 00 02 6F 02
		39 01 00 00 00 00 02 70 7F
		39 01 00 00 00 00 02 71 69
		39 01 00 00 00 00 02 72 59
		39 01 00 00 00 00 02 73 4C
		39 01 00 00 00 00 02 74 47
		39 01 00 00 00 00 02 75 38
		39 01 00 00 00 00 02 76 3D
		39 01 00 00 00 00 02 77 27
		39 01 00 00 00 00 02 78 41
		39 01 00 00 00 00 02 79 40
		39 01 00 00 00 00 02 7A 40
		39 01 00 00 00 00 02 7B 5B
		39 01 00 00 00 00 02 7C 46
		39 01 00 00 00 00 02 7D 49
		39 01 00 00 00 00 02 7E 3A
		39 01 00 00 00 00 02 7F 34
		39 01 00 00 00 00 02 80 25
		39 01 00 00 00 00 02 81 15
		39 01 00 00 00 00 02 82 02
		39 01 00 00 00 00 02 E0 02
		39 01 00 00 00 00 02 00 50
		39 01 00 00 00 00 02 01 55
		39 01 00 00 00 00 02 02 55
		39 01 00 00 00 00 02 03 52
		39 01 00 00 00 00 02 04 77
		39 01 00 00 00 00 02 05 57
		39 01 00 00 00 00 02 06 55
		39 01 00 00 00 00 02 07 4E
		39 01 00 00 00 00 02 08 4C
		39 01 00 00 00 00 02 09 55
		39 01 00 00 00 00 02 0A 4A
		39 01 00 00 00 00 02 0B 48
		39 01 00 00 00 00 02 0C 55
		39 01 00 00 00 00 02 0D 46
		39 01 00 00 00 00 02 0E 44
		39 01 00 00 00 00 02 0F 40
		39 01 00 00 00 00 02 10 55
		39 01 00 00 00 00 02 11 55
		39 01 00 00 00 00 02 12 55
		39 01 00 00 00 00 02 13 55
		39 01 00 00 00 00 02 14 55
		39 01 00 00 00 00 02 15 55
		39 01 00 00 00 00 02 16 51
		39 01 00 00 00 00 02 17 55
		39 01 00 00 00 00 02 18 55
		39 01 00 00 00 00 02 19 53
		39 01 00 00 00 00 02 1A 77
		39 01 00 00 00 00 02 1B 57
		39 01 00 00 00 00 02 1C 55
		39 01 00 00 00 00 02 1D 4F
		39 01 00 00 00 00 02 1E 4D
		39 01 00 00 00 00 02 1F 55
		39 01 00 00 00 00 02 20 4B
		39 01 00 00 00 00 02 21 49
		39 01 00 00 00 00 02 22 55
		39 01 00 00 00 00 02 23 47
		39 01 00 00 00 00 02 24 45
		39 01 00 00 00 00 02 25 41
		39 01 00 00 00 00 02 26 55
		39 01 00 00 00 00 02 27 55
		39 01 00 00 00 00 02 28 55
		39 01 00 00 00 00 02 29 55
		39 01 00 00 00 00 02 2A 55
		39 01 00 00 00 00 02 2B 55
		39 01 00 00 00 00 02 2C 01
		39 01 00 00 00 00 02 2D 15
		39 01 00 00 00 00 02 2E 15
		39 01 00 00 00 00 02 2F 13
		39 01 00 00 00 00 02 30 17
		39 01 00 00 00 00 02 31 17
		39 01 00 00 00 00 02 32 15
		39 01 00 00 00 00 02 33 0D
		39 01 00 00 00 00 02 34 0F
		39 01 00 00 00 00 02 35 15
		39 01 00 00 00 00 02 36 05
		39 01 00 00 00 00 02 37 07
		39 01 00 00 00 00 02 38 15
		39 01 00 00 00 00 02 39 09
		39 01 00 00 00 00 02 3A 0B
		39 01 00 00 00 00 02 3B 11
		39 01 00 00 00 00 02 3C 15
		39 01 00 00 00 00 02 3D 15
		39 01 00 00 00 00 02 3E 15
		39 01 00 00 00 00 02 3F 15
		39 01 00 00 00 00 02 40 15
		39 01 00 00 00 00 02 41 15
		39 01 00 00 00 00 02 42 00
		39 01 00 00 00 00 02 43 15
		39 01 00 00 00 00 02 44 15
		39 01 00 00 00 00 02 45 12
		39 01 00 00 00 00 02 46 17
		39 01 00 00 00 00 02 47 17
		39 01 00 00 00 00 02 48 15
		39 01 00 00 00 00 02 49 0C
		39 01 00 00 00 00 02 4A 0E
		39 01 00 00 00 00 02 4B 15
		39 01 00 00 00 00 02 4C 04
		39 01 00 00 00 00 02 4D 06
		39 01 00 00 00 00 02 4E 15
		39 01 00 00 00 00 02 4F 08
		39 01 00 00 00 00 02 50 0A
		39 01 00 00 00 00 02 51 10
		39 01 00 00 00 00 02 52 15
		39 01 00 00 00 00 02 53 15
		39 01 00 00 00 00 02 54 15
		39 01 00 00 00 00 02 55 15
		39 01 00 00 00 00 02 56 15
		39 01 00 00 00 00 02 57 15
		39 01 00 00 00 00 02 58 40
		39 01 00 00 00 00 02 5B 10
		39 01 00 00 00 00 02 5C 06
		39 01 00 00 00 00 02 5D 40
		39 01 00 00 00 00 02 5E 00
		39 01 00 00 00 00 02 5F 00
		39 01 00 00 00 00 02 60 40
		39 01 00 00 00 00 02 61 03
		39 01 00 00 00 00 02 62 04
		39 01 00 00 00 00 02 63 6C
		39 01 00 00 00 00 02 64 6C
		39 01 00 00 00 00 02 65 75
		39 01 00 00 00 00 02 66 08
		39 01 00 00 00 00 02 67 B4
		39 01 00 00 00 00 02 68 08
		39 01 00 00 00 00 02 69 6C
		39 01 00 00 00 00 02 6A 6C
		39 01 00 00 00 00 02 6B 0C
		39 01 00 00 00 00 02 6D 00
		39 01 00 00 00 00 02 6E 00
		39 01 00 00 00 00 02 6F 88
		39 01 00 00 00 00 02 75 BB
		39 01 00 00 00 00 02 76 00
		39 01 00 00 00 00 02 77 05
		39 01 00 00 00 00 02 78 2A
		39 01 00 00 00 00 02 E0 04
		39 01 00 00 00 00 02 09 11
		39 01 00 00 00 00 02 0E 48
		39 01 00 00 00 00 02 E0 00
		39 01 00 00 00 00 02 51 00
		39 01 00 00 00 00 02 53 2C
		39 01 00 00 00 00 02 55 01
		39 01 00 00 78 00 02 11 00
		39 01 00 00 14 00 02 29 00
		];
		qcom,mdss-dsi-off-command = [05 01 00 00 32 00 02 28 00
					05 01 00 00 78 00 02 10 00
					05 01 00 00 00 00 02 E0 01
					05 01 00 00 00 00 02 54 01];
		qcom,mdss-dsi-on-command-state = "dsi_lp_mode";
		qcom,mdss-dsi-off-command-state = "dsi_lp_mode";
		zte,mdss-dsi-cabc-default-value = <0x01>;
		zte,mdss-dsi-cabc-off-command = [39 01 00 00 00 00 02 55 00
		];
		zte,mdss-dsi-cabc-low-command = [39 01 00 00 00 00 02 55 01
		];
		zte,mdss-dsi-cabc-medium-command = [39 01 00 00 00 00 02 55 02
		];
		zte,mdss-dsi-cabc-high-command = [39 01 00 00 00 00 02 55 03
		];
		zte,mdss-dsi-cabc-command-state = "dsi_lp_mode";
		qcom,mdss-dsi-lp11-init;
		qcom,mdss-dsi-h-sync-pulse = <1>;
		qcom,mdss-dsi-traffic-mode = "burst_mode";
		qcom,mdss-dsi-lane-map = "lane_map_0123";
		qcom,mdss-dsi-bllp-eof-power-mode;
		qcom,mdss-dsi-bllp-power-mode;
		qcom,mdss-dsi-lane-0-state;
		qcom,mdss-dsi-lane-1-state;
		qcom,mdss-dsi-lane-2-state;
		qcom,mdss-dsi-lane-3-state;
		qcom,mdss-dsi-panel-timings = [7B 1A 10 00 3C 42 14 1C 15 03 04 00];
		qcom,mdss-dsi-t-clk-post = <0x04>;
		qcom,mdss-dsi-t-clk-pre = <0x1A>;
		qcom,mdss-dsi-bl-min-level = <1>;
		qcom,mdss-dsi-bl-max-level = <255>;
		qcom,mdss-dsi-dma-trigger = "trigger_sw";
		qcom,mdss-dsi-mdp-trigger = "none";
		qcom,mdss-dsi-bl-pmic-control-type = "bl_ctrl_dcs";
		qcom,mdss-dsi-reset-sequence = <1 10>, <0 5>, <1 10>;
		qcom,mdss-pan-physical-width-dimension = <107>;
		qcom,mdss-pan-physical-height-dimension = <172>;
		zte,lcm_backlight_curve_mode = "lcd_brightness_max_350_lux";
		qcom,mdss-dsi-tx-eot-append;
		/*qcom,esd-check-enabled;*/
		qcom,mdss-dsi-panel-status-command=[06 01 00 01 05 00 02 09 00];
		qcom,mdss-dsi-panel-status-command-state="dsi_lp_mode";
		qcom,mdss-dsi-panel-status-check-mode="reg_read";
		qcom,mdss-dsi-panel-status-value=<0x80 0x03 0x06>;
		qcom,mdss-dsi-panel-status-read-length = <3>;
	};
};
