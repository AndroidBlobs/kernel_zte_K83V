/* Copyright (c) 2013, The Linux Foundation. All rights reserved.
 *
 * This program is free software; you can redistribute it and/or modify
 * it under the terms of the GNU General Public License version 2 and
 * only version 2 as published by the Free Software Foundation.
 *
 * This program is distributed in the hope that it will be useful,
 * but WITHOUT ANY WARRANTY; without even the implied warranty of
 * MERCHANTABILITY or FITNESS FOR A PARTICULAR PURPOSE.  See the
 * GNU General Public License for more details.
 */

/*---------------------------------------------------------------------------
 * This file is autogenerated file using gcdb parser. Please do not edit it.
 * Update input XML file to add a new entry or update variable in this file
 * VERSION = "1.0"
 *---------------------------------------------------------------------------*/
&mdss_mdp {
	dsi_kingdisplay_hx8394_800p_video: qcom,mdss_dsi_kingdisplay_hx8394_800p_video {
		qcom,mdss-dsi-panel-name = "kingdisplay hx8394 800p video mode dsi panel";
		zte,lcd-init-code-version = "20181214";
		qcom,cont-splash-enabled;
		qcom,panel-supply-entries = <&dsi_panel_pwr_supply>;
		qcom,mdss-dsi-panel-controller = <&mdss_dsi0>;
		qcom,mdss-dsi-panel-type = "dsi_video_mode";
		qcom,mdss-dsi-panel-destination = "display_1";
		qcom,mdss-dsi-panel-framerate = <60>;
		/*qcom,mdss-dsi-panel-clockrate = <866400000>;*/
		qcom,mdss-dsi-virtual-channel-id = <0>;
		qcom,mdss-dsi-stream = <0>;
		qcom,mdss-dsi-panel-width = <800>;
		qcom,mdss-dsi-panel-height = <1280>;
		qcom,mdss-dsi-h-front-porch = <20>;
		qcom,mdss-dsi-h-back-porch = <40>;
		qcom,mdss-dsi-h-pulse-width = <12>;
		qcom,mdss-dsi-h-sync-skew = <0>;
		qcom,mdss-dsi-v-back-porch = <16>;
		qcom,mdss-dsi-v-front-porch = <12>;
		qcom,mdss-dsi-v-pulse-width = <8>;
		qcom,mdss-dsi-h-left-border = <0>;
		qcom,mdss-dsi-h-right-border = <0>;
		qcom,mdss-dsi-v-top-border = <0>;
		qcom,mdss-dsi-v-bottom-border = <0>;
		qcom,mdss-dsi-bpp = <24>;
		qcom,mdss-dsi-color-order = "rgb_swap_rgb";
		qcom,mdss-dsi-underflow-color = <0xff>;
		qcom,mdss-dsi-border-color = <0>;
		qcom,mdss-dsi-on-command = [39 01 00 00 00 00 04 b9 ff 83 94
39 01 00 00 00 00 03 ba 73 83
39 01 00 00 00 00 10 b1 6c 10 10 24 e4 11 f1 80 e4 d7 23 80 c0 d2 58
39 01 00 00 00 00 0b b2 00 64 10 07 20 1c 08 08 1c 4d
39 01 00 00 00 00 0d b4 00 ff 03 5a 03 5a 03 5a 01 62 01 62
39 01 00 00 00 00 03 b6 6f 6f
39 01 00 00 00 00 02 cc 09
39 01 00 00 00 00 1f d3 00 06 00 40 1a 08 00 32 10 07 00 07 54 15 0f 05
			04 02 12 10 05 07 33 33 0b 0b 37 10 07 07
39 01 00 00 00 00 2d d5 19 19 18 18 1a 1a 1b 1b 04 05 06 07 00 01 02 03
			20 21 18 18 18 18 18 18 18 18 18 18 18 18 22 23
			18 18 18 18 18 18 18 18 18 18 18 18
39 01 00 00 00 00 2d d6 18 18 19 19 1a 1a 1b 1b 03 02 01 00 07 06 05 04
			23 22 18 18 18 18 18 18 18 18 18 18 18 18 21 20
			18 18 18 18 18 18 18 18 18 18 18 18
39 01 00 00 00 00 2b e0 00 00 02 3c 3e 3f 0e 35 06 09 0a 19 0f 12 15 13
			14 07 12 15 16 00 00 01 3c 3e 3f 0e 35 07 09 0b
			12 0e 12 14 12 14 08 13 14 19
39 01 00 00 00 00 02 d2 55
39 01 00 00 00 00 06 c9 13 00 0a 8f 8f
39 01 00 00 00 00 03 c0 30 14
39 01 00 00 00 00 03 bf 41 0e
39 01 00 00 00 00 05 c7 00 c0 40 c0
39 01 00 00 00 00 02 df 8e
39 01 00 00 00 00 02 51 00
39 01 00 00 00 00 02 53 24
39 01 00 00 00 00 02 55 01
39 01 00 00 00 00 02 5e 04
39 01 00 00 78 00 02 11 00
39 01 00 00 20 00 02 29 00];
		qcom,mdss-dsi-off-command = [05 01 00 00 32 00 02 28 00
					05 01 00 00 78 00 02 10 00];
		qcom,mdss-dsi-on-command-state = "dsi_lp_mode";
		qcom,mdss-dsi-off-command-state = "dsi_lp_mode";
		zte,mdss-dsi-cabc-default-value = <0x01>;
		zte,mdss-dsi-cabc-off-command = [39 01 00 00 00 00 02 55 00
		];
		zte,mdss-dsi-cabc-low-command = [39 01 00 00 00 00 02 55 01
		];
		zte,mdss-dsi-cabc-medium-command = [39 01 00 00 00 00 02 55 02
		];
		zte,mdss-dsi-cabc-high-command = [39 01 00 00 00 00 02 55 03
		];
		zte,mdss-dsi-cabc-command-state = "dsi_lp_mode";
		qcom,mdss-dsi-lp11-init;
		qcom,mdss-dsi-h-sync-pulse = <1>;
		qcom,mdss-dsi-traffic-mode = "burst_mode";
		qcom,mdss-dsi-lane-map = "lane_map_0123";
		qcom,mdss-dsi-bllp-eof-power-mode;
		qcom,mdss-dsi-bllp-power-mode;
		qcom,mdss-dsi-lane-0-state;
		qcom,mdss-dsi-lane-1-state;
		qcom,mdss-dsi-lane-2-state;
		qcom,mdss-dsi-lane-3-state;
		qcom,mdss-dsi-panel-timings = [7B 1A 10 00 3E 40 16 1C 15 03 04 00];
		qcom,mdss-dsi-t-clk-post = <0x04>;
		qcom,mdss-dsi-t-clk-pre = <0x1A>;
		qcom,mdss-dsi-bl-min-level = <1>;
		qcom,mdss-dsi-bl-max-level = <255>;
		qcom,mdss-dsi-dma-trigger = "trigger_sw";
		qcom,mdss-dsi-mdp-trigger = "none";
		qcom,mdss-dsi-bl-pmic-control-type = "bl_ctrl_dcs";
		qcom,mdss-dsi-reset-sequence = <1 15>, <0 2>, <1 25>;
		qcom,mdss-pan-physical-width-dimension = <107>;
		qcom,mdss-pan-physical-height-dimension = <172>;
		zte,lcm_backlight_curve_mode = "lcd_brightness_max_350_lux";
		qcom,mdss-dsi-tx-eot-append;
		/*qcom,esd-check-enabled;*/
		qcom,mdss-dsi-panel-status-command=[06 01 00 01 05 00 02 09 00];
		qcom,mdss-dsi-panel-status-command-state="dsi_lp_mode";
		qcom,mdss-dsi-panel-status-check-mode="reg_read";
		qcom,mdss-dsi-panel-status-value=<0x80 0x03 0x06>;
		qcom,mdss-dsi-panel-status-read-length = <3>;
	};
};
